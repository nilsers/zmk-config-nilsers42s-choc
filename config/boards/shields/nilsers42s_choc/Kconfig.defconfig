## config/boards/shields/nilsers42s_choc/Kconfig.defconfig
```kconfig
if SHIELD_NILSERS42S_CHOC_LEFT

config ZMK_KEYBOARD_NAME
    default "nilsers42s-choc"

endif


if SHIELD_NILSERS42S_CHOC_LEFT || SHIELD_NILSERS42S_CHOC_RIGHT

config ZMK_SPLIT
    default y

endif
```

## config/boards/shields/nilsers42s_choc/Kconfig.shield
```kconfig
config SHIELD_NILSERS42S_CHOC_LEFT
    def_bool $(shields_list_contains, nilsers42s_choc_left)

config SHIELD_NILSERS42S_CHOC_RIGHT
    def_bool $(shields_list_contains, nilsers42s_choc_right)
```
